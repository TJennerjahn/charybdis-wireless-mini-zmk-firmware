## config/west.yml
```yaml
manifest:
  remotes:
    - name: zmkfirmware
      url-base: https://github.com/zmkfirmware

    - name: 280Zo
      url-base: https://github.com/280Zo

  projects:
    - name: zmk
      remote: zmkfirmware
      revision: 8feeb52eafc716c1697cfe0515e98b78281c3543
      import: app/west.yml

    - name: zmk-pmw3610-driver
      remote: 280Zo
      revision: a1a0f35ab6750c8fc72b84ea00add1e5fbaea1e4

  self:
    path: config
```
