## zmk-battery-print/Kconfig
```kconfig
menuconfig ZMK_BATTERY_PRINT
    bool "Battery print behavior module"
    default y
    help
      Provides a custom behavior to type split battery percentages into the host.
```

## zmk-battery-print/dts/bindings/behaviors/zmk,behavior-battery-print.yaml
```yaml
# Copyright (c) 2026
# SPDX-License-Identifier: MIT

description: Battery print behavior (types split battery percentages into the host).

compatible: "zmk,behavior-battery-print"

include: [zero_param.yaml]
```
